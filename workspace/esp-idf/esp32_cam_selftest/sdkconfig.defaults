## workspace/esp-idf/esp32_cam_selftest/sdkconfig.defaults
```kconfig
CONFIG_ESP32_SPIRAM_SUPPORT=y
CONFIG_SPIRAM=y
CONFIG_ESPTOOLPY_FLASHSIZE_4MB=y
CONFIG_ESPTOOLPY_FLASHSIZE="4MB"
CONFIG_LOG_DEFAULT_LEVEL_INFO=y
```
